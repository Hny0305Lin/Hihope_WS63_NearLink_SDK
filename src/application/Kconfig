## src/application/samples/peripheral/i2c/Kconfig
```kconfig
#===============================================================================
# @brief    Kconfig file.
# Copyright (c) HiSilicon (Shanghai) Technologies Co., Ltd. 2023-2023. All rights reserved.
#===============================================================================
config SAMPLE_SUPPORT_I2C_MASTER
    bool
    prompt "Support I2C Master Sample."
    default n
    depends on SAMPLE_SUPPORT_I2C
    help
        This option means support I2C Master Sample.

config I2C_MASTER_BUS_ID
    int
    prompt "Choose I2C master bus id."
    depends on SAMPLE_SUPPORT_I2C_MASTER
    default 2

config I2C_SCL_MASTER_PIN
    int
    prompt "Choose I2C SCL master pin."
    depends on SAMPLE_SUPPORT_I2C_MASTER
    default 8

config I2C_SDA_MASTER_PIN
    int
    prompt "Choose I2C SDA master pin."
    depends on SAMPLE_SUPPORT_I2C_MASTER
    default 9

config I2C_MASTER_PIN_MODE
    int
    prompt "Choose I2C master pin mode."
    depends on SAMPLE_SUPPORT_I2C_MASTER
    default 3

config SAMPLE_SUPPORT_I2C_SLAVE
    bool
    prompt "Support I2C Slave Sample."
    default n
    depends on SAMPLE_SUPPORT_I2C
    help
        This option means support I2C Slave Sample.

config I2C_SLAVE_BUS_ID
    int
    prompt "Choose I2C slave bus id."
    depends on SAMPLE_SUPPORT_I2C_SLAVE
    default 2

config I2C_SCL_SLAVE_PIN
    int
    prompt "Choose I2C SCL slave pin."
    depends on SAMPLE_SUPPORT_I2C_SLAVE
    default 8

config I2C_SDA_SLAVE_PIN
    int
    prompt "Choose I2C SDA slave pin."
    depends on SAMPLE_SUPPORT_I2C_SLAVE
    default 9

config I2C_SLAVE_PIN_MODE
    int
    prompt "Choose I2C slave pin mode."
    depends on SAMPLE_SUPPORT_I2C_SLAVE
    default 3

config I2C_TRANSFER_LEN
    int
    prompt "Choose I2C transfer length."
    depends on SAMPLE_SUPPORT_I2C
    default 8
```

## src/application/samples/peripheral/i2s_dma_lli/Kconfig
```kconfig
#===============================================================================
# @brief    Kconfig file.
# Copyright (c) HiSilicon (Shanghai) Technologies Co., Ltd. 2023-2023. All rights reserved.
#===============================================================================
config SAMPLE_SUPPORT_I2S_DMA_LLI_MASTER
    bool
    prompt "Support I2S Master Sample."
    default n
    depends on SAMPLE_SUPPORT_I2S_DMA_LLI
    help
        This option means support I2S Master Sample.

config SAMPLE_SUPPORT_I2S_DMA_LLI_SLAVE
    bool
    prompt "Support I2S Slave Sample."
    default n
    depends on SAMPLE_SUPPORT_I2S_DMA_LLI
    help
        This option means support I2S Slave Sample.

config I2S_TRANSFER_LEN_OF_DMA_LLI
    int
    prompt "Set the length of transfer by DMA."
    default 128
    help
        This option means the length of transfer by DMA.
```

## src/application/samples/peripheral/pinctrl/Kconfig
```kconfig
#===============================================================================
# @brief    Kconfig file.
# Copyright (c) HiSilicon (Shanghai) Technologies Co., Ltd. 2023-2023. All rights reserved.
#===============================================================================
config PINCTRL_USE_PIN
    int
    prompt "Choose Pinctrl use pin."
    depends on SAMPLE_SUPPORT_PINCTRL
    default 23
```

## src/application/samples/peripheral/pwm/Kconfig
```kconfig
#===============================================================================
# @brief    Kconfig file.
# Copyright (c) HiSilicon (Shanghai) Technologies Co., Ltd. 2023-2023. All rights reserved.
#===============================================================================
config PWM_CHANNEL
    int
    prompt "Choose PWM Test Channel."
    depends on SAMPLE_SUPPORT_PWM
    default 0

config PWM_GROUP_ID
    int
    prompt "Choose PWM Test Group ID."
    depends on SAMPLE_SUPPORT_PWM && PWM_USING_V151
    default 0

config PWM_PIN
    int
    prompt "Choose PWM pin."
    depends on SAMPLE_SUPPORT_PWM
    default 20

config PWM_PIN_MODE
    int
    prompt "Choose PWM pin mode."
    default 3
    depends on SAMPLE_SUPPORT_PWM
```

## src/application/samples/peripheral/sfc/Kconfig
```kconfig
#===============================================================================
# @brief    Kconfig file.
# Copyright (c) HiSilicon (Shanghai) Technologies Co., Ltd. 2023-2023. All rights reserved.
#===============================================================================
config SFC_SAMPLE_USER_ADDR
    hex
    prompt "choose SFC sample Start Address(Real address of the flash memory)."
    depends on SAMPLE_SUPPORT_SFC
    default 0x7C000

config SFC_SAMPLE_USER_SIZE
    hex
    prompt "choose SFC sample End Address(Real address of the flash memory)."
    depends on SAMPLE_SUPPORT_SFC
    default 0x1000
```

## src/application/samples/peripheral/spi/Kconfig
```kconfig
#===============================================================================
# @brief    Kconfig file.
# Copyright (c) HiSilicon (Shanghai) Technologies Co., Ltd. 2023-2023. All rights reserved.
#===============================================================================
config SAMPLE_SUPPORT_SPI_MASTER
    bool
    prompt "Support SPI Master Sample."
    default n
    depends on SAMPLE_SUPPORT_SPI
    help
        This option means support SPI Master Sample.

config SPI_MASTER_BUS_ID
    int
    prompt "Choose SPI master bus id."
    depends on SAMPLE_SUPPORT_SPI_MASTER
    default 2

config SPI_DI_MASTER_PIN
    int
    prompt "Choose SPI DI master pin."
    depends on SAMPLE_SUPPORT_SPI_MASTER
    default 16

config SPI_DO_MASTER_PIN
    int
    prompt "Choose SPI DO master pin."
    depends on SAMPLE_SUPPORT_SPI_MASTER
    default 17

config SPI_CLK_MASTER_PIN
    int
    prompt "Choose SPI CLK master pin."
    depends on SAMPLE_SUPPORT_SPI_MASTER
    default 18

config SPI_CS_MASTER_PIN
    int
    prompt "Choose SPI CS master pin."
    depends on SAMPLE_SUPPORT_SPI_MASTER
    default 19

config SPI_MASTER_PIN_MODE
    int
    prompt "Choose SPI master pin mode."
    depends on SAMPLE_SUPPORT_SPI_MASTER
    default 1

config SAMPLE_SUPPORT_SPI_SLAVE
    bool
    prompt "Support SPI Slave Sample."
    default n
    depends on SAMPLE_SUPPORT_SPI
    help
        This option means support SPI Slave Sample.

config SPI_SLAVE_BUS_ID
    int
    prompt "Choose SPI slave bus id."
    depends on SAMPLE_SUPPORT_SPI_SLAVE
    default 4

config SPI_DI_SLAVE_PIN
    int
    prompt "Choose SPI DI slave pin."
    depends on SAMPLE_SUPPORT_SPI_SLAVE
    default 12

config SPI_DO_SLAVE_PIN
    int
    prompt "Choose SPI DO slave pin."
    depends on SAMPLE_SUPPORT_SPI_SLAVE
    default 13

config SPI_CLK_SLAVE_PIN
    int
    prompt "Choose SPI CLK slave pin."
    depends on SAMPLE_SUPPORT_SPI_SLAVE
    default 14

config SPI_CS_SLAVE_PIN
    int
    prompt "Choose SPI CS slave pin."
    depends on SAMPLE_SUPPORT_SPI_SLAVE
    default 15

config SPI_SLAVE_PIN_MODE
    int
    prompt "Choose SPI slave pin mode."
    depends on SAMPLE_SUPPORT_SPI_SLAVE
    default 5

config SPI_TRANSFER_LEN
    int
    prompt "Choose SPI transfer length."
    depends on SAMPLE_SUPPORT_SPI
    default 8
```

## src/application/samples/peripheral/uart/Kconfig
```kconfig
#===============================================================================
# @brief    Kconfig file.
# Copyright (c) HiSilicon (Shanghai) Technologies Co., Ltd. 2023-2023. All rights reserved.
#===============================================================================
config UART0_BUS_ID
    int
    prompt "Choose UART0 bus id."
    depends on SAMPLE_SUPPORT_UART
    default 0

config UART0_TXD_PIN
    int
    prompt "Choose UART0 TXD pin."
    depends on SAMPLE_SUPPORT_UART
    default 47

config UART0_RXD_PIN
    int
    prompt "Choose UART0 RXD pin."
    depends on SAMPLE_SUPPORT_UART
    default 46

config UART0_PIN_MODE
    int
    prompt "Choose UART0 pin mode."
    depends on SAMPLE_SUPPORT_UART
    default 1

config UART_POLL_TRANSFER_MODE
    bool
    prompt "Choose UART poll transfer mode."
    depends on SAMPLE_SUPPORT_UART
    default y

config UART_INT_TRANSFER_MODE
    bool
    prompt "Choose UART interrupt transfer mode."
    depends on SAMPLE_SUPPORT_UART
    default n

config UART_DMA_TRANSFER_MODE
    bool
    prompt "Choose UART dma transfer mode."
    depends on SAMPLE_SUPPORT_UART
    default n
```

## src/application/samples/radar/Kconfig
```kconfig
#===============================================================================
# @brief    Kconfig file.
# Copyright (c) HiSilicon (Shanghai) Technologies Co., Ltd. 2023-2023. All rights reserved.
#===============================================================================
choice
    prompt "Sample"

config SUPPORT_RADAR_STA_SAMPLE
    bool "Support RADAR STA Sample"

config SUPPORT_RADAR_SOFTAP_SAMPLE
    bool "Support RADAR SoftAP Sample."
endchoice
```

## src/application/samples/wifi/Kconfig
```kconfig
#===============================================================================
# @brief    Kconfig file.
# Copyright (c) HiSilicon (Shanghai) Technologies Co., Ltd. 2023-2023. All rights reserved.
#===============================================================================
choice
    prompt "Sample"

config SAMPLE_SUPPORT_STA_SAMPLE
    bool "Support WIFI STA Sample"

config SAMPLE_SUPPORT_SOFTAP_SAMPLE
    bool "Support WIFI SoftAP Sample."

config SAMPLE_SUPPORT_BLE_WIFI_CFG_SAMPLE
    bool "Support BLE WIFI CFG Sample"

config SUPPORT_HILINK
    bool "Support HILINK"

config SUPPORT_UAPI
    bool "Support UAPI."
endchoice

config SAMPLE_SUPPORT_SYSCHANNEL_DEV
    bool
    prompt "Support Syschannel dev Sample."
    default n
    help
        This option means support Syschannel Dev Sample.
```

## vendor/HiHope_NearLink_DK_WS63E_V03/demo/radar_led/Kconfig
```kconfig
#===============================================================================
# @brief    Kconfig file.
# Copyright (c) @CompanyNameMagicTag 2023-2023. All rights reserved.
#===============================================================================
config SAMPLE_SUPPORT_RADAR_STA
    bool
    prompt "Support RADAR_STA Sample."
    default n
    depends on SAMPLE_SUPPORT_RADAR_LED
    help
        This option means support RADAR_STA Sample.

config SAMPLE_SUPPORT_RADAR_SOFTAP
    bool
    prompt "Support RADAR_SOFTAP Sample."
    default n
    depends on SAMPLE_SUPPORT_RADAR_LED
    help
        This option means support RADAR_SOFTAP Sample.
```

## vendor/HiHope_NearLink_DK_WS63E_V03/demo/sle_throughput/Kconfig
```kconfig
#===============================================================================
# @brief    Kconfig file.
# Copyright (c) @CompanyNameMagicTag 2023-2023. All rights reserved.
#===============================================================================
config SAMPLE_SUPPORT_SLE_SERVER_SPEED
    bool
    prompt "Support SLE_SERVER_SPEED Sample."
    default n
    depends on SAMPLE_SUPPORT_SLE_THROUGHPUT
    help
        This option means support SLE_SERVER_SPEED Sample.

config SAMPLE_SUPPORT_SLE_CLIENT_SPEED
    bool
    prompt "Support SLE_CLIENT_SPEED  Sample."
    default n
    depends on SAMPLE_SUPPORT_SLE_THROUGHPUT
    help
        This option means support SLE_CLIENT_SPEED Sample.
```
